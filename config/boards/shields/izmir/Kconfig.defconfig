## config/boards/shields/izmir/Kconfig.defconfig
```kconfig
# Copyright (c) 2025 The ZMK Contributors
# SPDX-License-Identifier: MIT

if SHIELD_IZMIR_LEFT

config ZMK_KEYBOARD_NAME
    default "Izmir"

config ZMK_SPLIT_ROLE_CENTRAL
    default y

endif

if SHIELD_IZMIR_LEFT || SHIELD_IZMIR_RIGHT

config ZMK_SPLIT
    default y

endif
```

## config/boards/shields/izmir/Kconfig.shield
```kconfig
# Copyright (c) 2025 The ZMK Contributors
# SPDX-License-Identifier: MIT

config SHIELD_IZMIR_LEFT
    def_bool $(shields_list_contains,izmir_left)

config SHIELD_IZMIR_RIGHT
    def_bool $(shields_list_contains,izmir_right)
```
